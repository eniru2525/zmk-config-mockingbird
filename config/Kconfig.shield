## config/Kconfig.shield
```kconfig
# Copyright (c) 2020 The ZMK Contributors
# SPDX-License-Identifier: MIT

config SHIELD_MOCKINGBIRD
   def_bool $(shields_list_contains,mockingbird)
```

## config/boards/shields/mockingbird/Kconfig.defconfig
```kconfig
# Copyright (c) 2020 The ZMK Contributors
# SPDX-License-Identifier: MIT

if SHIELD_MOCKINGBIRD

config ZMK_KEYBOARD_NAME
    default "MOCKINGBIRD"

endif
```
